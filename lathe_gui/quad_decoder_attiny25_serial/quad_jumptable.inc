; Quadrature decoder jump table. Generated by GenerateSamplesDecoder.java program; 256 combinations of 4 consecutive samples.
;  * That would be hard and error prone to write by hand.
;  * The stdout of this program was copy-pasted into the quad decoder asm program.
; 00->00->00->00 000 0x200    00->00->00->01 00- 0x201
.org 0b0100000000
.db 0, -1
; 00->00->01->00 0-+ 0x202    00->00->01->01 0-0 0x203
.org 0b0100000001
.db 0, -1
; 00->00->00->10 00+ 0x204    00->00->00->11 00E 0x205
.org 0b0100000010
.db 1, 4
; 00->00->01->10 0-E 0x206    00->00->01->11 0-- 0x207
.org 0b0100000011
.db 4, -2
; 00->00->10->00 0+- 0x208    00->00->10->01 0+E 0x209
.org 0b0100000100
.db 0, 4
; 00->00->11->00 0EE 0x20a    00->00->11->01 0E+ 0x20b
.org 0b0100000101
.db 4, 4
; 00->00->10->10 0+0 0x20c    00->00->10->11 0++ 0x20d
.org 0b0100000110
.db 1, 2
; 00->00->11->10 0E- 0x20e    00->00->11->11 0E0 0x20f
.org 0b0100000111
.db 4, 4
; 01->00->00->00 +00 0x210    01->00->00->01 +0- 0x211
.org 0b0100001000
.db 1, 0
; 01->00->01->00 +-+ 0x212    01->00->01->01 +-0 0x213
.org 0b0100001001
.db 1, 0
; 01->00->00->10 +0+ 0x214    01->00->00->11 +0E 0x215
.org 0b0100001010
.db 2, 4
; 01->00->01->10 +-E 0x216    01->00->01->11 +-- 0x217
.org 0b0100001011
.db 4, -1
; 01->00->10->00 ++- 0x218    01->00->10->01 ++E 0x219
.org 0b0100001100
.db 1, 4
; 01->00->11->00 +EE 0x21a    01->00->11->01 +E+ 0x21b
.org 0b0100001101
.db 4, 4
; 01->00->10->10 ++0 0x21c    01->00->10->11 +++ 0x21d
.org 0b0100001110
.db 2, 3
; 01->00->11->10 +E- 0x21e    01->00->11->11 +E0 0x21f
.org 0b0100001111
.db 4, 4
; 00->01->00->00 -+0 0x220    00->01->00->01 -+- 0x221
.org 0b0100010000
.db 0, -1
; 00->01->01->00 -0+ 0x222    00->01->01->01 -00 0x223
.org 0b0100010001
.db 0, -1
; 00->01->00->10 -++ 0x224    00->01->00->11 -+E 0x225
.org 0b0100010010
.db 1, 4
; 00->01->01->10 -0E 0x226    00->01->01->11 -0- 0x227
.org 0b0100010011
.db 4, -2
; 00->01->10->00 -E- 0x228    00->01->10->01 -EE 0x229
.org 0b0100010100
.db 4, 4
; 00->01->11->00 --E 0x22a    00->01->11->01 --+ 0x22b
.org 0b0100010101
.db 4, -1
; 00->01->10->10 -E0 0x22c    00->01->10->11 -E+ 0x22d
.org 0b0100010110
.db 4, 4
; 00->01->11->10 --- 0x22e    00->01->11->11 --0 0x22f
.org 0b0100010111
.db -3, -2
; 01->01->00->00 0+0 0x230    01->01->00->01 0+- 0x231
.org 0b0100011000
.db 1, 0
; 01->01->01->00 00+ 0x232    01->01->01->01 000 0x233
.org 0b0100011001
.db 1, 0
; 01->01->00->10 0++ 0x234    01->01->00->11 0+E 0x235
.org 0b0100011010
.db 2, 4
; 01->01->01->10 00E 0x236    01->01->01->11 00- 0x237
.org 0b0100011011
.db 4, -1
; 01->01->10->00 0E- 0x238    01->01->10->01 0EE 0x239
.org 0b0100011100
.db 4, 4
; 01->01->11->00 0-E 0x23a    01->01->11->01 0-+ 0x23b
.org 0b0100011101
.db 4, 0
; 01->01->10->10 0E0 0x23c    01->01->10->11 0E+ 0x23d
.org 0b0100011110
.db 4, 4
; 01->01->11->10 0-- 0x23e    01->01->11->11 0-0 0x23f
.org 0b0100011111
.db -2, -1
; 10->00->00->00 -00 0x240    10->00->00->01 -0- 0x241
.org 0b0100100000
.db -1, -2
; 10->00->01->00 --+ 0x242    10->00->01->01 --0 0x243
.org 0b0100100001
.db -1, -2
; 10->00->00->10 -0+ 0x244    10->00->00->11 -0E 0x245
.org 0b0100100010
.db 0, 4
; 10->00->01->10 --E 0x246    10->00->01->11 --- 0x247
.org 0b0100100011
.db 4, -3
; 10->00->10->00 -+- 0x248    10->00->10->01 -+E 0x249
.org 0b0100100100
.db -1, 4
; 10->00->11->00 -EE 0x24a    10->00->11->01 -E+ 0x24b
.org 0b0100100101
.db 4, 4
; 10->00->10->10 -+0 0x24c    10->00->10->11 -++ 0x24d
.org 0b0100100110
.db 0, 1
; 10->00->11->10 -E- 0x24e    10->00->11->11 -E0 0x24f
.org 0b0100100111
.db 4, 4
; 11->00->00->00 E00 0x250    11->00->00->01 E0- 0x251
.org 0b0100101000
.db 4, 4
; 11->00->01->00 E-+ 0x252    11->00->01->01 E-0 0x253
.org 0b0100101001
.db 4, 4
; 11->00->00->10 E0+ 0x254    11->00->00->11 E0E 0x255
.org 0b0100101010
.db 4, 4
; 11->00->01->10 E-E 0x256    11->00->01->11 E-- 0x257
.org 0b0100101011
.db 4, 4
; 11->00->10->00 E+- 0x258    11->00->10->01 E+E 0x259
.org 0b0100101100
.db 4, 4
; 11->00->11->00 EEE 0x25a    11->00->11->01 EE+ 0x25b
.org 0b0100101101
.db 4, 4
; 11->00->10->10 E+0 0x25c    11->00->10->11 E++ 0x25d
.org 0b0100101110
.db 4, 4
; 11->00->11->10 EE- 0x25e    11->00->11->11 EE0 0x25f
.org 0b0100101111
.db 4, 4
; 10->01->00->00 E+0 0x260    10->01->00->01 E+- 0x261
.org 0b0100110000
.db 4, 4
; 10->01->01->00 E0+ 0x262    10->01->01->01 E00 0x263
.org 0b0100110001
.db 4, 4
; 10->01->00->10 E++ 0x264    10->01->00->11 E+E 0x265
.org 0b0100110010
.db 4, 4
; 10->01->01->10 E0E 0x266    10->01->01->11 E0- 0x267
.org 0b0100110011
.db 4, 4
; 10->01->10->00 EE- 0x268    10->01->10->01 EEE 0x269
.org 0b0100110100
.db 4, 4
; 10->01->11->00 E-E 0x26a    10->01->11->01 E-+ 0x26b
.org 0b0100110101
.db 4, 4
; 10->01->10->10 EE0 0x26c    10->01->10->11 EE+ 0x26d
.org 0b0100110110
.db 4, 4
; 10->01->11->10 E-- 0x26e    10->01->11->11 E-0 0x26f
.org 0b0100110111
.db 4, 4
; 11->01->00->00 ++0 0x270    11->01->00->01 ++- 0x271
.org 0b0100111000
.db 2, 1
; 11->01->01->00 +0+ 0x272    11->01->01->01 +00 0x273
.org 0b0100111001
.db 2, 1
; 11->01->00->10 +++ 0x274    11->01->00->11 ++E 0x275
.org 0b0100111010
.db 3, 4
; 11->01->01->10 +0E 0x276    11->01->01->11 +0- 0x277
.org 0b0100111011
.db 4, 0
; 11->01->10->00 +E- 0x278    11->01->10->01 +EE 0x279
.org 0b0100111100
.db 4, 4
; 11->01->11->00 +-E 0x27a    11->01->11->01 +-+ 0x27b
.org 0b0100111101
.db 4, 1
; 11->01->10->10 +E0 0x27c    11->01->10->11 +E+ 0x27d
.org 0b0100111110
.db 4, 4
; 11->01->11->10 +-- 0x27e    11->01->11->11 +-0 0x27f
.org 0b0100111111
.db -1, 0
; 00->10->00->00 +-0 0x280    00->10->00->01 +-- 0x281
.org 0b0101000000
.db 0, -1
; 00->10->01->00 +E+ 0x282    00->10->01->01 +E0 0x283
.org 0b0101000001
.db 4, 4
; 00->10->00->10 +-+ 0x284    00->10->00->11 +-E 0x285
.org 0b0101000010
.db 1, 4
; 00->10->01->10 +EE 0x286    00->10->01->11 +E- 0x287
.org 0b0101000011
.db 4, 4
; 00->10->10->00 +0- 0x288    00->10->10->01 +0E 0x289
.org 0b0101000100
.db 0, 4
; 00->10->11->00 ++E 0x28a    00->10->11->01 +++ 0x28b
.org 0b0101000101
.db 4, 3
; 00->10->10->10 +00 0x28c    00->10->10->11 +0+ 0x28d
.org 0b0101000110
.db 1, 2
; 00->10->11->10 ++- 0x28e    00->10->11->11 ++0 0x28f
.org 0b0101000111
.db 1, 2
; 01->10->00->00 E-0 0x290    01->10->00->01 E-- 0x291
.org 0b0101001000
.db 4, 4
; 01->10->01->00 EE+ 0x292    01->10->01->01 EE0 0x293
.org 0b0101001001
.db 4, 4
; 01->10->00->10 E-+ 0x294    01->10->00->11 E-E 0x295
.org 0b0101001010
.db 4, 4
; 01->10->01->10 EEE 0x296    01->10->01->11 EE- 0x297
.org 0b0101001011
.db 4, 4
; 01->10->10->00 E0- 0x298    01->10->10->01 E0E 0x299
.org 0b0101001100
.db 4, 4
; 01->10->11->00 E+E 0x29a    01->10->11->01 E++ 0x29b
.org 0b0101001101
.db 4, 4
; 01->10->10->10 E00 0x29c    01->10->10->11 E0+ 0x29d
.org 0b0101001110
.db 4, 4
; 01->10->11->10 E+- 0x29e    01->10->11->11 E+0 0x29f
.org 0b0101001111
.db 4, 4
; 00->11->00->00 EE0 0x2a0    00->11->00->01 EE- 0x2a1
.org 0b0101010000
.db 4, 4
; 00->11->01->00 E++ 0x2a2    00->11->01->01 E+0 0x2a3
.org 0b0101010001
.db 4, 4
; 00->11->00->10 EE+ 0x2a4    00->11->00->11 EEE 0x2a5
.org 0b0101010010
.db 4, 4
; 00->11->01->10 E+E 0x2a6    00->11->01->11 E+- 0x2a7
.org 0b0101010011
.db 4, 4
; 00->11->10->00 E-- 0x2a8    00->11->10->01 E-E 0x2a9
.org 0b0101010100
.db 4, 4
; 00->11->11->00 E0E 0x2aa    00->11->11->01 E0+ 0x2ab
.org 0b0101010101
.db 4, 4
; 00->11->10->10 E-0 0x2ac    00->11->10->11 E-+ 0x2ad
.org 0b0101010110
.db 4, 4
; 00->11->11->10 E0- 0x2ae    00->11->11->11 E00 0x2af
.org 0b0101010111
.db 4, 4
; 01->11->00->00 -E0 0x2b0    01->11->00->01 -E- 0x2b1
.org 0b0101011000
.db 4, 4
; 01->11->01->00 -++ 0x2b2    01->11->01->01 -+0 0x2b3
.org 0b0101011001
.db 1, 0
; 01->11->00->10 -E+ 0x2b4    01->11->00->11 -EE 0x2b5
.org 0b0101011010
.db 4, 4
; 01->11->01->10 -+E 0x2b6    01->11->01->11 -+- 0x2b7
.org 0b0101011011
.db 4, -1
; 01->11->10->00 --- 0x2b8    01->11->10->01 --E 0x2b9
.org 0b0101011100
.db -3, 4
; 01->11->11->00 -0E 0x2ba    01->11->11->01 -0+ 0x2bb
.org 0b0101011101
.db 4, 0
; 01->11->10->10 --0 0x2bc    01->11->10->11 --+ 0x2bd
.org 0b0101011110
.db -2, -1
; 01->11->11->10 -0- 0x2be    01->11->11->11 -00 0x2bf
.org 0b0101011111
.db -2, -1
; 10->10->00->00 0-0 0x2c0    10->10->00->01 0-- 0x2c1
.org 0b0101100000
.db -1, -2
; 10->10->01->00 0E+ 0x2c2    10->10->01->01 0E0 0x2c3
.org 0b0101100001
.db 4, 4
; 10->10->00->10 0-+ 0x2c4    10->10->00->11 0-E 0x2c5
.org 0b0101100010
.db 0, 4
; 10->10->01->10 0EE 0x2c6    10->10->01->11 0E- 0x2c7
.org 0b0101100011
.db 4, 4
; 10->10->10->00 00- 0x2c8    10->10->10->01 00E 0x2c9
.org 0b0101100100
.db -1, 4
; 10->10->11->00 0+E 0x2ca    10->10->11->01 0++ 0x2cb
.org 0b0101100101
.db 4, 2
; 10->10->10->10 000 0x2cc    10->10->10->11 00+ 0x2cd
.org 0b0101100110
.db 0, 1
; 10->10->11->10 0+- 0x2ce    10->10->11->11 0+0 0x2cf
.org 0b0101100111
.db 0, 1
; 11->10->00->00 --0 0x2d0    11->10->00->01 --- 0x2d1
.org 0b0101101000
.db -2, -3
; 11->10->01->00 -E+ 0x2d2    11->10->01->01 -E0 0x2d3
.org 0b0101101001
.db 4, 4
; 11->10->00->10 --+ 0x2d4    11->10->00->11 --E 0x2d5
.org 0b0101101010
.db -1, 4
; 11->10->01->10 -EE 0x2d6    11->10->01->11 -E- 0x2d7
.org 0b0101101011
.db 4, 4
; 11->10->10->00 -0- 0x2d8    11->10->10->01 -0E 0x2d9
.org 0b0101101100
.db -2, 4
; 11->10->11->00 -+E 0x2da    11->10->11->01 -++ 0x2db
.org 0b0101101101
.db 4, 1
; 11->10->10->10 -00 0x2dc    11->10->10->11 -0+ 0x2dd
.org 0b0101101110
.db -1, 0
; 11->10->11->10 -+- 0x2de    11->10->11->11 -+0 0x2df
.org 0b0101101111
.db -1, 0
; 10->11->00->00 +E0 0x2e0    10->11->00->01 +E- 0x2e1
.org 0b0101110000
.db 4, 4
; 10->11->01->00 +++ 0x2e2    10->11->01->01 ++0 0x2e3
.org 0b0101110001
.db 3, 2
; 10->11->00->10 +E+ 0x2e4    10->11->00->11 +EE 0x2e5
.org 0b0101110010
.db 4, 4
; 10->11->01->10 ++E 0x2e6    10->11->01->11 ++- 0x2e7
.org 0b0101110011
.db 4, 1
; 10->11->10->00 +-- 0x2e8    10->11->10->01 +-E 0x2e9
.org 0b0101110100
.db -1, 4
; 10->11->11->00 +0E 0x2ea    10->11->11->01 +0+ 0x2eb
.org 0b0101110101
.db 4, 2
; 10->11->10->10 +-0 0x2ec    10->11->10->11 +-+ 0x2ed
.org 0b0101110110
.db 0, 1
; 10->11->11->10 +0- 0x2ee    10->11->11->11 +00 0x2ef
.org 0b0101110111
.db 0, 1
; 11->11->00->00 0E0 0x2f0    11->11->00->01 0E- 0x2f1
.org 0b0101111000
.db 4, 4
; 11->11->01->00 0++ 0x2f2    11->11->01->01 0+0 0x2f3
.org 0b0101111001
.db 2, 1
; 11->11->00->10 0E+ 0x2f4    11->11->00->11 0EE 0x2f5
.org 0b0101111010
.db 4, 4
; 11->11->01->10 0+E 0x2f6    11->11->01->11 0+- 0x2f7
.org 0b0101111011
.db 4, 0
; 11->11->10->00 0-- 0x2f8    11->11->10->01 0-E 0x2f9
.org 0b0101111100
.db -2, 4
; 11->11->11->00 00E 0x2fa    11->11->11->01 00+ 0x2fb
.org 0b0101111101
.db 4, 1
; 11->11->10->10 0-0 0x2fc    11->11->10->11 0-+ 0x2fd
.org 0b0101111110
.db -1, 0
; 11->11->11->10 00- 0x2fe    11->11->11->11 000 0x2ff
.org 0b0101111111
.db -1, 0

