; Quadrature decoder jump table. Generated by GenerateSamplesDecoder.java program; 256 combinations of 4 consecutive samples.
;  * That would be hard and error prone to write by hand.
;  * The stdout of this program was copy-pasted into the quad decoder asm program.
; 00->00->00->00 000 0x200    00->00->00->01 00- 0x201
.org 0b0100000000
.db 0, -1
; 00->00->01->00 0-+ 0x202    00->00->01->01 0-0 0x203
.db 0, -1
; 00->00->00->10 00+ 0x204    00->00->00->11 00E 0x205
.db 1, 4
; 00->00->01->10 0-E 0x206    00->00->01->11 0-- 0x207
.db 4, -2
; 00->00->10->00 0+- 0x208    00->00->10->01 0+E 0x209
.db 0, 4
; 00->00->11->00 0EE 0x20a    00->00->11->01 0E+ 0x20b
.db 4, 4
; 00->00->10->10 0+0 0x20c    00->00->10->11 0++ 0x20d
.db 1, 2
; 00->00->11->10 0E- 0x20e    00->00->11->11 0E0 0x20f
.db 4, 4
; 01->00->00->00 +00 0x210    01->00->00->01 +0- 0x211
.db 1, 0
; 01->00->01->00 +-+ 0x212    01->00->01->01 +-0 0x213
.db 1, 0
; 01->00->00->10 +0+ 0x214    01->00->00->11 +0E 0x215
.db 2, 4
; 01->00->01->10 +-E 0x216    01->00->01->11 +-- 0x217
.db 4, -1
; 01->00->10->00 ++- 0x218    01->00->10->01 ++E 0x219
.db 1, 4
; 01->00->11->00 +EE 0x21a    01->00->11->01 +E+ 0x21b
.db 4, 4
; 01->00->10->10 ++0 0x21c    01->00->10->11 +++ 0x21d
.db 2, 3
; 01->00->11->10 +E- 0x21e    01->00->11->11 +E0 0x21f
.db 4, 4
; 00->01->00->00 -+0 0x220    00->01->00->01 -+- 0x221
.db 0, -1
; 00->01->01->00 -0+ 0x222    00->01->01->01 -00 0x223
.db 0, -1
; 00->01->00->10 -++ 0x224    00->01->00->11 -+E 0x225
.db 1, 4
; 00->01->01->10 -0E 0x226    00->01->01->11 -0- 0x227
.db 4, -2
; 00->01->10->00 -E- 0x228    00->01->10->01 -EE 0x229
.db 4, 4
; 00->01->11->00 --E 0x22a    00->01->11->01 --+ 0x22b
.db 4, -1
; 00->01->10->10 -E0 0x22c    00->01->10->11 -E+ 0x22d
.db 4, 4
; 00->01->11->10 --- 0x22e    00->01->11->11 --0 0x22f
.db -3, -2
; 01->01->00->00 0+0 0x230    01->01->00->01 0+- 0x231
.db 1, 0
; 01->01->01->00 00+ 0x232    01->01->01->01 000 0x233
.db 1, 0
; 01->01->00->10 0++ 0x234    01->01->00->11 0+E 0x235
.db 2, 4
; 01->01->01->10 00E 0x236    01->01->01->11 00- 0x237
.db 4, -1
; 01->01->10->00 0E- 0x238    01->01->10->01 0EE 0x239
.db 4, 4
; 01->01->11->00 0-E 0x23a    01->01->11->01 0-+ 0x23b
.db 4, 0
; 01->01->10->10 0E0 0x23c    01->01->10->11 0E+ 0x23d
.db 4, 4
; 01->01->11->10 0-- 0x23e    01->01->11->11 0-0 0x23f
.db -2, -1
; 10->00->00->00 -00 0x240    10->00->00->01 -0- 0x241
.db -1, -2
; 10->00->01->00 --+ 0x242    10->00->01->01 --0 0x243
.db -1, -2
; 10->00->00->10 -0+ 0x244    10->00->00->11 -0E 0x245
.db 0, 4
; 10->00->01->10 --E 0x246    10->00->01->11 --- 0x247
.db 4, -3
; 10->00->10->00 -+- 0x248    10->00->10->01 -+E 0x249
.db -1, 4
; 10->00->11->00 -EE 0x24a    10->00->11->01 -E+ 0x24b
.db 4, 4
; 10->00->10->10 -+0 0x24c    10->00->10->11 -++ 0x24d
.db 0, 1
; 10->00->11->10 -E- 0x24e    10->00->11->11 -E0 0x24f
.db 4, 4
; 11->00->00->00 E00 0x250    11->00->00->01 E0- 0x251
.db 4, 4
; 11->00->01->00 E-+ 0x252    11->00->01->01 E-0 0x253
.db 4, 4
; 11->00->00->10 E0+ 0x254    11->00->00->11 E0E 0x255
.db 4, 4
; 11->00->01->10 E-E 0x256    11->00->01->11 E-- 0x257
.db 4, 4
; 11->00->10->00 E+- 0x258    11->00->10->01 E+E 0x259
.db 4, 4
; 11->00->11->00 EEE 0x25a    11->00->11->01 EE+ 0x25b
.db 4, 4
; 11->00->10->10 E+0 0x25c    11->00->10->11 E++ 0x25d
.db 4, 4
; 11->00->11->10 EE- 0x25e    11->00->11->11 EE0 0x25f
.db 4, 4
; 10->01->00->00 E+0 0x260    10->01->00->01 E+- 0x261
.db 4, 4
; 10->01->01->00 E0+ 0x262    10->01->01->01 E00 0x263
.db 4, 4
; 10->01->00->10 E++ 0x264    10->01->00->11 E+E 0x265
.db 4, 4
; 10->01->01->10 E0E 0x266    10->01->01->11 E0- 0x267
.db 4, 4
; 10->01->10->00 EE- 0x268    10->01->10->01 EEE 0x269
.db 4, 4
; 10->01->11->00 E-E 0x26a    10->01->11->01 E-+ 0x26b
.db 4, 4
; 10->01->10->10 EE0 0x26c    10->01->10->11 EE+ 0x26d
.db 4, 4
; 10->01->11->10 E-- 0x26e    10->01->11->11 E-0 0x26f
.db 4, 4
; 11->01->00->00 ++0 0x270    11->01->00->01 ++- 0x271
.db 2, 1
; 11->01->01->00 +0+ 0x272    11->01->01->01 +00 0x273
.db 2, 1
; 11->01->00->10 +++ 0x274    11->01->00->11 ++E 0x275
.db 3, 4
; 11->01->01->10 +0E 0x276    11->01->01->11 +0- 0x277
.db 4, 0
; 11->01->10->00 +E- 0x278    11->01->10->01 +EE 0x279
.db 4, 4
; 11->01->11->00 +-E 0x27a    11->01->11->01 +-+ 0x27b
.db 4, 1
; 11->01->10->10 +E0 0x27c    11->01->10->11 +E+ 0x27d
.db 4, 4
; 11->01->11->10 +-- 0x27e    11->01->11->11 +-0 0x27f
.db -1, 0
; 00->10->00->00 +-0 0x280    00->10->00->01 +-- 0x281
.db 0, -1
; 00->10->01->00 +E+ 0x282    00->10->01->01 +E0 0x283
.db 4, 4
; 00->10->00->10 +-+ 0x284    00->10->00->11 +-E 0x285
.db 1, 4
; 00->10->01->10 +EE 0x286    00->10->01->11 +E- 0x287
.db 4, 4
; 00->10->10->00 +0- 0x288    00->10->10->01 +0E 0x289
.db 0, 4
; 00->10->11->00 ++E 0x28a    00->10->11->01 +++ 0x28b
.db 4, 3
; 00->10->10->10 +00 0x28c    00->10->10->11 +0+ 0x28d
.db 1, 2
; 00->10->11->10 ++- 0x28e    00->10->11->11 ++0 0x28f
.db 1, 2
; 01->10->00->00 E-0 0x290    01->10->00->01 E-- 0x291
.db 4, 4
; 01->10->01->00 EE+ 0x292    01->10->01->01 EE0 0x293
.db 4, 4
; 01->10->00->10 E-+ 0x294    01->10->00->11 E-E 0x295
.db 4, 4
; 01->10->01->10 EEE 0x296    01->10->01->11 EE- 0x297
.db 4, 4
; 01->10->10->00 E0- 0x298    01->10->10->01 E0E 0x299
.db 4, 4
; 01->10->11->00 E+E 0x29a    01->10->11->01 E++ 0x29b
.db 4, 4
; 01->10->10->10 E00 0x29c    01->10->10->11 E0+ 0x29d
.db 4, 4
; 01->10->11->10 E+- 0x29e    01->10->11->11 E+0 0x29f
.db 4, 4
; 00->11->00->00 EE0 0x2a0    00->11->00->01 EE- 0x2a1
.db 4, 4
; 00->11->01->00 E++ 0x2a2    00->11->01->01 E+0 0x2a3
.db 4, 4
; 00->11->00->10 EE+ 0x2a4    00->11->00->11 EEE 0x2a5
.db 4, 4
; 00->11->01->10 E+E 0x2a6    00->11->01->11 E+- 0x2a7
.db 4, 4
; 00->11->10->00 E-- 0x2a8    00->11->10->01 E-E 0x2a9
.db 4, 4
; 00->11->11->00 E0E 0x2aa    00->11->11->01 E0+ 0x2ab
.db 4, 4
; 00->11->10->10 E-0 0x2ac    00->11->10->11 E-+ 0x2ad
.db 4, 4
; 00->11->11->10 E0- 0x2ae    00->11->11->11 E00 0x2af
.db 4, 4
; 01->11->00->00 -E0 0x2b0    01->11->00->01 -E- 0x2b1
.db 4, 4
; 01->11->01->00 -++ 0x2b2    01->11->01->01 -+0 0x2b3
.db 1, 0
; 01->11->00->10 -E+ 0x2b4    01->11->00->11 -EE 0x2b5
.db 4, 4
; 01->11->01->10 -+E 0x2b6    01->11->01->11 -+- 0x2b7
.db 4, -1
; 01->11->10->00 --- 0x2b8    01->11->10->01 --E 0x2b9
.db -3, 4
; 01->11->11->00 -0E 0x2ba    01->11->11->01 -0+ 0x2bb
.db 4, 0
; 01->11->10->10 --0 0x2bc    01->11->10->11 --+ 0x2bd
.db -2, -1
; 01->11->11->10 -0- 0x2be    01->11->11->11 -00 0x2bf
.db -2, -1
; 10->10->00->00 0-0 0x2c0    10->10->00->01 0-- 0x2c1
.db -1, -2
; 10->10->01->00 0E+ 0x2c2    10->10->01->01 0E0 0x2c3
.db 4, 4
; 10->10->00->10 0-+ 0x2c4    10->10->00->11 0-E 0x2c5
.db 0, 4
; 10->10->01->10 0EE 0x2c6    10->10->01->11 0E- 0x2c7
.db 4, 4
; 10->10->10->00 00- 0x2c8    10->10->10->01 00E 0x2c9
.db -1, 4
; 10->10->11->00 0+E 0x2ca    10->10->11->01 0++ 0x2cb
.db 4, 2
; 10->10->10->10 000 0x2cc    10->10->10->11 00+ 0x2cd
.db 0, 1
; 10->10->11->10 0+- 0x2ce    10->10->11->11 0+0 0x2cf
.db 0, 1
; 11->10->00->00 --0 0x2d0    11->10->00->01 --- 0x2d1
.db -2, -3
; 11->10->01->00 -E+ 0x2d2    11->10->01->01 -E0 0x2d3
.db 4, 4
; 11->10->00->10 --+ 0x2d4    11->10->00->11 --E 0x2d5
.db -1, 4
; 11->10->01->10 -EE 0x2d6    11->10->01->11 -E- 0x2d7
.db 4, 4
; 11->10->10->00 -0- 0x2d8    11->10->10->01 -0E 0x2d9
.db -2, 4
; 11->10->11->00 -+E 0x2da    11->10->11->01 -++ 0x2db
.db 4, 1
; 11->10->10->10 -00 0x2dc    11->10->10->11 -0+ 0x2dd
.db -1, 0
; 11->10->11->10 -+- 0x2de    11->10->11->11 -+0 0x2df
.db -1, 0
; 10->11->00->00 +E0 0x2e0    10->11->00->01 +E- 0x2e1
.db 4, 4
; 10->11->01->00 +++ 0x2e2    10->11->01->01 ++0 0x2e3
.db 3, 2
; 10->11->00->10 +E+ 0x2e4    10->11->00->11 +EE 0x2e5
.db 4, 4
; 10->11->01->10 ++E 0x2e6    10->11->01->11 ++- 0x2e7
.db 4, 1
; 10->11->10->00 +-- 0x2e8    10->11->10->01 +-E 0x2e9
.db -1, 4
; 10->11->11->00 +0E 0x2ea    10->11->11->01 +0+ 0x2eb
.db 4, 2
; 10->11->10->10 +-0 0x2ec    10->11->10->11 +-+ 0x2ed
.db 0, 1
; 10->11->11->10 +0- 0x2ee    10->11->11->11 +00 0x2ef
.db 0, 1
; 11->11->00->00 0E0 0x2f0    11->11->00->01 0E- 0x2f1
.db 4, 4
; 11->11->01->00 0++ 0x2f2    11->11->01->01 0+0 0x2f3
.db 2, 1
; 11->11->00->10 0E+ 0x2f4    11->11->00->11 0EE 0x2f5
.db 4, 4
; 11->11->01->10 0+E 0x2f6    11->11->01->11 0+- 0x2f7
.db 4, 0
; 11->11->10->00 0-- 0x2f8    11->11->10->01 0-E 0x2f9
.db -2, 4
; 11->11->11->00 00E 0x2fa    11->11->11->01 00+ 0x2fb
.db 4, 1
; 11->11->10->10 0-0 0x2fc    11->11->10->11 0-+ 0x2fd
.db -1, 0
; 11->11->11->10 00- 0x2fe    11->11->11->11 000 0x2ff
.db -1, 0
